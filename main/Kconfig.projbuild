## main/Kconfig.projbuild
```kconfig
menu "GPIO Change Notifier App"

    config GCN_HOST_NAME
        string "Host name"
        default "gcn"
        help
            Name to report to the server in the notifications

    config GCN_WATCH_GPIO_NUMBER
        int "GPIO number to watch"
        default 5
        help
            Will be set as input with pullup

    config GCN_WIFI_SSID
        string "WiFi SSID"
        default "myssid"
        help
            SSID (network name) for the example to connect to.

    config GCN_WIFI_PASSWORD
        string "WiFi Password"
        default "mypassword"
        help
            WiFi password (WPA or WPA2) for the example to use.

    config GCN_NOTIFY_URL
        string "Notification URL"
        default "http://myip/mypath"
        help
            URL to target for notifications, hostname will be appended to the path

    config GCN_IDLE_NOTIFICATION_INTERVAL
        int "Seconds between heartbeat"
        default 60
        help
            Will trigger a forced notification as a heartbeat
        
endmenu
```
